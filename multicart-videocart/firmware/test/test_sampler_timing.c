// ======================================================================
// test_sampler_timing.c — cycle proof for the sampler and follower.
//
// Decodes the ACTUAL assembler output (bus_pio.pio.h, generated by pioasm
// during preflight) and walks the programs mechanically, so the numbers
// asserted here are the ones the silicon will execute -- not a
// transcription of the listing, which is exactly the kind of thing that
// drifts and then fails on the bench.
//
// Asserts, in sysclk cycles from the `wait 0 gpio 8` release (R):
//
//  1. SETTLE. Every `mov osr, pins` in phases 1-3 happens at least
//     SETTLE_MIN cycles after the SEL value it samples under was set,
//     minus the 2-cycle pad synchroniser. Too short re-introduces
//     intermittent wrong-address bits on real hardware.
//  2. LATENCY. The `push` completes early enough that the DMA lookup and
//     the serve SM still beat the 6809E's data-setup deadline.
//  3. E-LOW. The whole sweep finishes inside E-low, so SEL is parked at 0
//     for all of E-high -- which is what makes GP20 read as live R/W for
//     the serve SM's `jmp pin` gate.
//  4. PAIRING. The follower's four `in pins, 14` land on exactly the same
//     cycles as the sampler's four `mov osr, pins`. If these ever drift,
//     the snoop silently mirrors bytes against the wrong address.
// ======================================================================

#include <stdio.h>
#include <stdint.h>

// Generated by pioasm into the test directory by the Makefile rule.
#include "config.h"
#include "hardware/clocks.h"

// Set before the generated header, which brings in the .pio's c-sdk block
// and with it bus_pio_div(). The test then exercises the REAL divider
// arithmetic the firmware runs, not a restatement of it.
uint32_t shim_clk_sys_hz = MC_SYS_CLK_KHZ * 1000u;

#include "gen_bus_pio.h"

// The PIO REFERENCE clock, not clk_sys. Every sample position below is
// expressed in PIO cycles, and the state machines are pinned to this rate
// by bus_pio_div() whatever clk_sys happens to be -- which is what makes
// the 250 MHz system clock safe. If those two ever disagree, every timing
// figure in this file is measuring a clock the hardware is not using.
#define CLK_MHZ         (MC_PIO_REF_KHZ / 1000u)
#define NS(cycles)      ((cycles) * 1000 / CLK_MHZ)
#define SYNC_CYCLES     2       // pad input synchroniser
#define SETTLE_MIN      7       // effective cycles ('153 ~43 ns at 5 V)
#define E_LOW_NS        558
#define PUSH_MAX_NS     520     // leaves >500 ns for DMA + drive + setup

static int failures;
#define CHECK(cond, ...) do { \
    if (!(cond)) { failures++; printf("FAIL: " __VA_ARGS__); putchar('\n'); } \
} while (0)

// ---- PIO instruction decoding (RP2350 encoding) ---------------------
#define OP(w)        (((w) >> 13) & 7u)
#define DELAY_SS(w)  (((w) >>  8) & 0x1Fu)   // delay+side-set field
#define OP_JMP 0u
#define OP_IN  2u
#define OP_OUT 3u
#define OP_PUSH_PULL 4u
#define OP_MOV 5u
#define OP_SET 7u

// With N side-set bits (no side_en), the top N bits of the 5-bit field
// are side-set and the rest is delay.
static uint32_t delay_of(uint16_t w, int sideset_bits) {
    return DELAY_SS(w) & ((1u << (5 - sideset_bits)) - 1u);
}
static uint32_t side_of(uint16_t w, int sideset_bits) {
    return DELAY_SS(w) >> (5 - sideset_bits);
}
static int is_mov_osr_pins(uint16_t w) {
    // MOV: op=5, dst in [7:5], src in [2:0]. dst=OSR(7), src=PINS(0),
    // op_mode none(0).
    return OP(w) == OP_MOV && ((w >> 5) & 7u) == 7u && (w & 7u) == 0u;
}
static int is_in_pins(uint16_t w) {
    return OP(w) == OP_IN && ((w >> 5) & 7u) == 0u;   // src = PINS
}
static int is_push(uint16_t w) {
    return OP(w) == OP_PUSH_PULL && ((w >> 7) & 1u) == 0u;  // 0 = push
}

// Walk a program from its `wait 0 gpio 8` and record, for each
// instruction, the cycle it ISSUES on (relative to that wait's release).
#define MAXI 40
typedef struct {
    uint32_t start[MAXI];       // issue cycle of instruction i
    uint32_t side[MAXI];        // side-set value it drives
    int      n;
} trace_t;

static void trace(const uint16_t *prog, int len, int sideset_bits,
                  trace_t *t) {
    // Find the second wait (the `wait 0 gpio 8`); everything before it is
    // the resync and takes unbounded time.
    int start = 0;
    for (int i = 0; i < len; i++) {
        if (OP(prog[i]) == 1u) {            // WAIT
            if (((prog[i] >> 7) & 1u) == 0u) { start = i; break; }
        }
    }
    uint32_t cyc = 0;
    t->n = 0;
    for (int i = start; i < len && t->n < MAXI; i++) {
        // The wait's own delay runs after it releases.
        t->start[t->n] = (i == start) ? 0 : cyc;
        t->side[t->n]  = side_of(prog[i], sideset_bits);
        t->n++;
        cyc += 1 + delay_of(prog[i], sideset_bits);
    }
}

int main(void) {
    trace_t s, f;
    trace(mux_sampler_program_instructions,
          (int)(sizeof(mux_sampler_program_instructions) / 2), 2, &s);
    trace(sweep_follower_program_instructions,
          (int)(sizeof(sweep_follower_program_instructions) / 2), 0, &f);

    // ---- collect the sampler's four sample instants ------------------
    uint32_t samp[8]; int ns = 0;
    uint32_t push_cycle = 0; int have_push = 0;
    for (int i = 0; i < s.n; i++) {
        uint16_t w = mux_sampler_program_instructions[
                         (int)(sizeof(mux_sampler_program_instructions) / 2)
                         - s.n + i];
        if (is_mov_osr_pins(w) && ns < 8) samp[ns++] = s.start[i];
        if (is_push(w) && !have_push) { push_cycle = s.start[i]; have_push = 1; }
    }
    CHECK(ns == 4, "sampler has %d pin snapshots, expected 4", ns);
    CHECK(have_push, "sampler never pushes");
    if (ns != 4 || !have_push) { printf("test_sampler_timing: ABORT\n"); return 1; }

    // ---- 1. settle: SEL flip -> next snapshot ------------------------
    // Phase 0 is exempt: SEL has rested at 0 since the previous E-high.
    for (int p = 1; p < 4; p++) {
        // The SEL value phase p samples under is set by the first
        // instruction after phase p-1's snapshot.
        uint32_t flip = 0;
        for (int i = 0; i < s.n; i++)
            if (s.start[i] > samp[p - 1]) { flip = s.start[i]; break; }
        uint32_t effective = (samp[p] - flip) - SYNC_CYCLES;
        CHECK(effective >= SETTLE_MIN,
              "phase %d settle %u cycles (%u ns) < %d required",
              p, effective, (unsigned)NS(effective), SETTLE_MIN);
        printf("  phase %d: SEL flip @%u, sample @%u -> %u eff cycles"
               " (%u ns)\n", p, flip, samp[p], effective,
               (unsigned)NS(effective));
    }

    // ---- 2. push latency ---------------------------------------------
    uint32_t push_ns = NS(push_cycle);
    CHECK(push_ns <= PUSH_MAX_NS,
          "push at %u ns > %d ns budget", (unsigned)push_ns, PUSH_MAX_NS);
    printf("  push @cycle %u = %u ns (budget %d ns)\n",
           push_cycle, (unsigned)push_ns, PUSH_MAX_NS);

    // ---- 3. the sweep must finish inside E-low -----------------------
    uint32_t last = samp[3];
    CHECK(NS(last) < E_LOW_NS,
          "last sample at %u ns is past E-low (%d ns)",
          (unsigned)NS(last), E_LOW_NS);

    // ---- 4. follower pairing -----------------------------------------
    uint32_t fs[8]; int nf = 0;
    for (int i = 0; i < f.n; i++) {
        uint16_t w = sweep_follower_program_instructions[
                         (int)(sizeof(sweep_follower_program_instructions) / 2)
                         - f.n + i];
        if (is_in_pins(w) && nf < 8) fs[nf++] = f.start[i];
    }
    CHECK(nf == 4, "follower has %d pin samples, expected 4", nf);
    for (int p = 0; p < 4 && p < nf; p++) {
        CHECK(fs[p] == samp[p],
              "follower phase %d samples at cycle %u, sampler at %u"
              " -- the snoop would read a different phase", p, fs[p], samp[p]);
        printf("  follower phase %d @%u == sampler @%u\n", p, fs[p], samp[p]);
    }

    // ---- the system clock may not drag the sweep with it ----
    // mux_sampler side-sets 2 bits, so its delay field is 3 bits wide and
    // SAMP_SETUP0 is already 7. The constants CANNOT be scaled, so the
    // only safe way to raise clk_sys is to pin the state machines. These
    // checks are what stands between that and a silent re-timing of every
    // sample the board takes.
    CHECK(MC_SYS_CLK_KHZ % MC_PIO_REF_KHZ == 0,
          "clk_sys %u kHz is not an integer multiple of the PIO reference "
          "%u kHz -- a fractional divider dithers the cycle length",
          (unsigned)MC_SYS_CLK_KHZ, (unsigned)MC_PIO_REF_KHZ);

    {
        // The divider the firmware will actually program -- its own
        // function, not a restatement of it. This is the assertion that
        // makes a 250 MHz clk_sys safe: if the pinning is ever removed,
        // the sweep silently re-times and every figure above becomes a
        // measurement of a clock the hardware is not running at.
        shim_clk_sys_hz = MC_SYS_CLK_KHZ * 1000u;
        float div = bus_pio_div();
        CHECK(div == (float)MC_SYS_CLK_KHZ / (float)MC_PIO_REF_KHZ,
              "bus_pio_div() returns %.4f at clk_sys %u kHz; the sweep "
              "needs %.4f to keep its cycles at %u kHz", (double)div,
              (unsigned)MC_SYS_CLK_KHZ,
              (double)MC_SYS_CLK_KHZ / (double)MC_PIO_REF_KHZ,
              (unsigned)MC_PIO_REF_KHZ);

        // And it must still be 1.0 if anyone puts the clock back.
        shim_clk_sys_hz = MC_PIO_REF_KHZ * 1000u;
        CHECK(bus_pio_div() == 1.0f,
              "bus_pio_div() is %.4f at the reference clock, want 1.0",
              (double)bus_pio_div());
        shim_clk_sys_hz = MC_SYS_CLK_KHZ * 1000u;
        CHECK(div >= 1.0f, "PIO divider %.3f is below 1", (double)div);
        CHECK(div == (float)(int)div,
              "PIO divider %.3f is fractional", (double)div);
        CHECK(div <= 65536.0f, "PIO divider %.3f exceeds the 16-bit field",
              (double)div);
    }

    // Every delay in the sampler must still fit the 3-bit field that
    // side-setting 2 leaves behind. This is the wall that stopped the
    // obvious approach; keep it visible.
    for (int i = 0; i < (int)(sizeof(mux_sampler_program_instructions) / 2);
         i++) {
        uint16_t w = mux_sampler_program_instructions[i];
        uint32_t ds = (w >> 8) & 0x1Fu;          // delay|side-set field
        // With .side_set 2 the low 3 bits are delay and the top 2 are the
        // side-set value, so a delay above 7 is unrepresentable and would
        // have silently become a side-set change instead.
        CHECK((ds & 0x7u) <= 7u,
              "sampler word %d encodes a delay above 7", i);
    }

    // The follower does NOT side-set, so it has the full 5-bit delay
    // field. Checking the encoding rather than the source constant is the
    // stronger claim: it is what the silicon will execute.
    for (int i = 0; i < (int)(sizeof(sweep_follower_program_instructions) / 2);
         i++) {
        uint16_t w = sweep_follower_program_instructions[i];
        CHECK(((w >> 8) & 0x1Fu) <= 31u,
              "follower word %d encodes an impossible delay", i);
    }

    if (failures) {
        printf("test_sampler_timing: %d FAILURES\n", failures);
        return 1;
    }
    printf("test_sampler_timing: OK (settle >= %d cyc, push %u ns, "
           "follower paired, PIO pinned across clk_sys)\n", SETTLE_MIN, (unsigned)push_ns);
    return 0;
}
